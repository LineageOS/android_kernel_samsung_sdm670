## arch/arm64/Kconfig.sec
```kconfig
config SEC_GTS4LV_PROJECT
        depends on ARCH_SDM670
        default n
        bool "Samsung GTS4LV Project"
        help
          Support for Samsung GTS4LV Project

config SEC_GTS4LV_MEA_PROJECT
        depends on SEC_GTS4LV_PROJECT
        default n
        bool "Samsung GTS4LV MEA Project"
        help
          Support for Samsung GTS4LV MEA Project

config SEC_GTS4LV_EUR_PROJECT
        depends on SEC_GTS4LV_PROJECT
        default n
        bool "Samsung GTS4LV EUR OPEN Project"
        help
          Support for Samsung GTS4LV EUR OPEN Project

config SEC_GTS4LVWIFI_EUR_PROJECT
        depends on SEC_GTS4LV_PROJECT
        default n
        bool "Samsung GTS4LVWIFI EUR OPEN Project"
        help
          Support for Samsung GTS4LVWIFI EUR OPEN Project

config SEC_GTS4LVWIFI_EUR_LDU_PROJECT
        depends on SEC_GTS4LV_PROJECT
        default n
        bool "Samsung GTS4LVWIFI EUR LDU Project"
        help
          Support for Samsung GTS4LVWIFI EUR LDU Project

config SEC_GTS4LV_KOR_PROJECT
        depends on SEC_GTS4LV_PROJECT
        default n
        bool "Samsung GTS4LV KOR OPEN Project"
        help
          Support for Samsung GTS4LV KOR OPEN Project

config SEC_GTS4LV_USA_PROJECT
        depends on SEC_GTS4LV_PROJECT
        default n
        bool "Samsung GTS4LV USA Project"
        help
          Support for Samsung GTS4LV USA Project
```

## arch/arm64/configs/sdm670_sec_gts4lv_usa_usc_defconfig
```kconfig
# sdm710_sec_gts4lv_usa_usc_defconfig

CONFIG_SEC_GTS4LV_PROJECT=y
CONFIG_SEC_GTS4LV_USA_PROJECT=y
CONFIG_POS_LAUNCH_PROJECT=y

# QCA Wi-Fi feature
CONFIG_QCA_CLD_WLAN=y
CONFIG_QCACLD_WLAN_LFR2=y
CONFIG_QCACLD_WLAN_LFR3=y
CONFIG_QCOM_TDLS=y
CONFIG_QCACLD_FEATURE_METERING=y
CONFIG_QCACLD_FEATURE_GREEN_AP=y
CONFIG_QCOM_VOWIFI_11R=y
CONFIG_WLAN_FEATURE_11W=y
CONFIG_QCOM_LTE_COEX=y
CONFIG_WLAN_FEATURE_LPSS=y
CONFIG_QCACLD_FEATURE_NAN=y
CONFIG_WLAN_FEATURE_NAN_DATAPATH=y
CONFIG_MPC_UT_FRAMEWORK=y
CONFIG_WLAN_OFFLOAD_PACKETS=y
CONFIG_WLAN_SYNC_TSF=y
CONFIG_WLAN_FEATURE_MEMDUMP=y
CONFIG_WLAN_FEATURE_DISA=y
CONFIG_WLAN_FASTPATH=y
CONFIG_WLAN_NAPI=y
CONFIG_WLAN_TX_FLOW_CONTROL_V2=y
CONFIG_LFR_SUBNET_DETECTION=y
CONFIG_MCC_TO_SCC_SWITCH=y
CONFIG_WLAN_LRO=y
CONFIG_ICNSS=y
CONFIG_CNSS_UTILS=y
CONFIG_WLAN_BEACON_CHECK=y
# CONFIG_FORCE_ALLOC_FROM_DMA_ZONE is not set
CONFIG_QCACLD_FEATURE_GREEN_AP=y
CONFIG_WCNSS_MEM_PRE_ALLOC=y

# input
CONFIG_TOUCHSCREEN_STM_FTS1BA90A=y
# CONFIG_INPUT_SEC_SECURE_TOUCH is not set
CONFIG_KEYBOARD_STM32_POGO=y

# PM
CONFIG_REGULATOR_S2MPB03=y

# Display
CONFIG_PANEL_ANA38401_AMSA05RB01_WQXGA=y
CONFIG_PLL_SSC_DISABLED=y

#MUIC configs
CONFIG_MFD_CORE=y
CONFIG_USE_MUIC=y
CONFIG_MUIC_NOTIFIER=y
CONFIG_MUIC_SUPPORT_CCIC=y
CONFIG_VBUS_NOTIFIER=y
CONFIG_VBUS_NOTIFIER_WORK=y
CONFIG_MUIC_HV=y
CONFIG_HICCUP_CHARGER=y

#MUIC-SM5705
CONFIG_MFD_SM5705=y
CONFIG_MUIC_UNIVERSAL=y
CONFIG_MUIC_UNIVERSAL_SM5705=y
CONFIG_MUIC_UNIVERSAL_SM5705_AFC=y
CONFIG_MUIC_SM5705_SWITCH_CONTROL_GPIO=y
CONFIG_MUIC_PINCTRL=y
# CONFIG_MUIC_UNIVERSAL_MULTI_SUPPORT is not set
# CONFIG_MUIC_SUPPORT_RUSTPROOF is not set
CONFIG_MUIC_SUPPORT_KEYBOARDDOCK=y

#CCIC configs
CONFIG_CCIC_NOTIFIER=y
CONFIG_CCIC_S2MM005=y
CONFIG_CCIC_ALTERNATE_MODE=y
CONFIG_CCIC_LPM_ENABLE=y
CONFIG_CCIC_S2MM005_ANALOG_AUDIO=y

#redriver
CONFIG_COMBO_REDRIVER=y

# FPGA
CONFIG_FPGA=y
CONFIG_POGO_FPGA=y

#displayport
CONFIG_SEC_DISPLAYPORT=y
CONFIG_SEC_DISPLAYPORT_LOGGER=y
CONFIG_SEC_DISPLAYPORT_BIGDATA=y

# BATTERY configs
CONFIG_BATTERY_SAMSUNG=y
CONFIG_BATTERY_SAMSUNG_V2=y
CONFIG_BATTERY_NOTIFIER=y
CONFIG_AFC_CHARGER_MODE=y
CONFIG_SAMSUNG_LPM_MODE=y
CONFIG_BATTERY_SWELLING=y
CONFIG_CHARGER_SM5705=y
CONFIG_FUELGAUGE_SM5705=y
CONFIG_USE_POGO=y
CONFIG_CALC_TIME_TO_FULL=y
# CONFIG_AFC_CURR_CONTROL_BY_TEMP=y
CONFIG_BATTERY_AGE_FORECAST=y
# CONFIG_UPDATE_BATTERY_DATA is not set
CONFIG_BATTERY_CISD=y
CONFIG_TABLET_MODEL_CONCEPT=y
CONFIG_ENABLE_100MA_CHARGING_BEFORE_USB_CONFIGURED=y

# Audio
CONFIG_SND_SOC_CS35L41=y
CONFIG_MFD_CS35L41_I2C=y

#Camera
#CONFIG_LEDS_SM5705=y
#CONFIG_LEDS_SEPARATE_PREFLASH=y
#CONFIG_SAMSUNG_OIS_RUMBA_S4=y
#CONFIG_SAMSUNG_OIS_RUMBA_S6=y
CONFIG_DISABLE_OIS_SDM710=y
CONFIG_SAMSUNG_FRONT_EEPROM=y
CONFIG_CAMERA_SYSFS_V2=y
#CONFIG_SAMSUNG_SECURE_CAMERA=y
CONFIG_SAMSUNG_MULTI_CAMERA=y
CONFIG_CAMERA_DYNAMIC_MIPI=y
CONFIG_CAMERA_FRS_DRAM_TEST=y
CONFIG_USE_CAMERA_HW_BIG_DATA=y
CONFIG_CAMERA_SSM_I2C_ENV=y
CONFIG_S5K5E9YX=y

# Sensor
CONFIG_SENSORS=y
CONFIG_SENSORS_SSC=y
CONFIG_ADSP_FACTORY=y
CONFIG_LSM6DSM_FACTORY=y
CONFIG_AK09918_FACTORY=y
CONFIG_VEML3328_FACTORY=y

# Grip Sensor
CONFIG_SENSORS_SX9330=y
CONFIG_SENSORS_SX9330_WIFI=y

# Finger print sensor
CONFIG_SENSORS_FINGERPRINT=y
CONFIG_SENSORS_ET5XX=y
CONFIG_SENSORS_FP_SPI_NUMBER=15
CONFIG_SENSORS_FP_SPI_GPIO_START=81
CONFIG_SENSORS_FP_SPI_GPIO_END=84

#Motor
CONFIG_MSM_VIBRATOR=y

#FreeCess
CONFIG_SAMSUNG_FREECESS=y

#Storage
CONFIG_SCSI_UFSHCD=n
CONFIG_SCSI_UFSHCD_PLATFORM=n
CONFIG_SCSI_UFS_QCOM=n
CONFIG_SCSI_UFS_QCOM_ICE=n
CONFIG_SCSI_UFSHCD_CMD_LOGGING=n
CONFIG_UFS_DATA_LOG=n
CONFIG_UFS_DATA_LOG_MAGIC_CODE=n

# Audio
CONFIG_SND_SOC_DBMDX=y
CONFIG_SND_SOC_DBMDX_SND_CAPTURE=y
CONFIG_SND_SOC_DBMDX_VA_NS_SUPPORT=y

# Linux On Dex
CONFIG_USER_NS=y
CONFIG_POSIX_MQUEUE=y
CONFIG_VETH=y
CONFIG_UTS_NS=y
CONFIG_PID_NS=y
CONFIG_CGROUP_PIDS=y
CONFIG_CGROUP_DEVICE=y
CONFIG_MEMCG=y
CONFIG_MEMCG_SWAP=y
CONFIG_NET_CLS_CGROUP=y
CONFIG_LOD_SEC=y

# Hall ic
CONFIG_SENSORS_HALL=y
# CONFIG_CERTIFY_HALL=y
```

## arch/arm64/configs/sdm670_sec_userdebug_defconfig
```kconfig
CONFIG_GATOR=y

# CONFIG_RKP_KDP is not set
# CONFIG_RKP_NS_PROT is not set

# streamline
CONFIG_PROFILING=y
CONFIG_PERF_EVENTS=y
CONFIG_HIGH_RES_TIMERS=y
CONFIG_HW_PERF_EVENTS=y
CONFIG_LOCAL_TIMERS=y
```

## arch/arm64/configs/sdm710_sec_a8sqlte_kor_single_defconfig
```kconfig
# sdm710_sec_a8sqlte_kor_single_defconfig

CONFIG_SEC_A8SQLTE_PROJECT=y
CONFIG_MACH_A8SQLTE_KOR_SINGLE=y

# QCA Wi-Fi feature
CONFIG_QCA_CLD_WLAN=y
CONFIG_QCACLD_WLAN_LFR2=y
CONFIG_QCACLD_WLAN_LFR3=y
CONFIG_QCOM_TDLS=y
CONFIG_QCACLD_FEATURE_METERING=y
CONFIG_QCACLD_FEATURE_GREEN_AP=y
CONFIG_QCOM_VOWIFI_11R=y
CONFIG_WLAN_FEATURE_11W=y
CONFIG_QCOM_LTE_COEX=y
CONFIG_WLAN_FEATURE_LPSS=y
CONFIG_QCACLD_FEATURE_NAN=y
CONFIG_WLAN_FEATURE_NAN_DATAPATH=y
CONFIG_MPC_UT_FRAMEWORK=y
CONFIG_WLAN_OFFLOAD_PACKETS=y
CONFIG_WLAN_SYNC_TSF=y
CONFIG_WLAN_FEATURE_MEMDUMP=y
CONFIG_WLAN_FEATURE_DISA=y
CONFIG_WLAN_FASTPATH=y
CONFIG_WLAN_NAPI=y
CONFIG_WLAN_TX_FLOW_CONTROL_V2=y
CONFIG_LFR_SUBNET_DETECTION=y
CONFIG_MCC_TO_SCC_SWITCH=y
CONFIG_WLAN_LRO=y
CONFIG_ICNSS=y
CONFIG_CNSS_UTILS=y
# CONFIG_FORCE_ALLOC_FROM_DMA_ZONE is not set
CONFIG_QCACLD_FEATURE_GREEN_AP=y
CONFIG_WCNSS_MEM_PRE_ALLOC=y

# input
CONFIG_TOUCHSCREEN_ZINITIX_ZT75XX=y
CONFIG_TOUCHSCREEN_SYNAPTICS_TS_TD4300=y
CONFIG_TOUCHSCREEN_NOVATEK_NT36672=y

# PM
CONFIG_REGULATOR_S2MPB03=y

# display
CONFIG_PANEL_NT36672A_BS063YPM_FHD=y
CONFIG_PANEL_NT36672A_B6P064YQ5LP_FHD=y

#CONFIG_PANEL_TD4300_BS055FHM_FHD=y
CONFIG_BLIC_ISL98611=y

#CONFIG_PANEL_S6E3FA7_AMS628RF01_FHD=y
#CONFIG_SUPPORT_POC_FLASH=n

#MUIC configs
CONFIG_MFD_CORE=y
CONFIG_USE_MUIC=y
CONFIG_MUIC_NOTIFIER=y
CONFIG_MUIC_SUPPORT_CCIC=y
CONFIG_VBUS_NOTIFIER=y
CONFIG_VBUS_NOTIFIER_WORK=y
CONFIG_MUIC_HV=y
CONFIG_HICCUP_CHARGER=y

#MUIC-SM5705
CONFIG_MFD_SM5705=y
CONFIG_MUIC_UNIVERSAL=y
CONFIG_MUIC_UNIVERSAL_SM5705=y
CONFIG_MUIC_UNIVERSAL_SM5705_AFC=y
CONFIG_MUIC_SM5705_SWITCH_CONTROL_GPIO=y
CONFIG_MUIC_PINCTRL=y
# CONFIG_MUIC_UNIVERSAL_MULTI_SUPPORT is not set
# CONFIG_MUIC_SUPPORT_RUSTPROOF is not set

#CCIC configs
CONFIG_CCIC_NOTIFIER=y
CONFIG_CCIC_S2MM005=y
CONFIG_CCIC_ALTERNATE_MODE=y
CONFIG_CCIC_LPM_ENABLE=y
CONFIG_CCIC_S2MM005_ANALOG_AUDIO=y
# CONFIG_SEC_DISPLAYPORT is not set

# BATTERY configs
CONFIG_BATTERY_SAMSUNG=y
CONFIG_BATTERY_SAMSUNG_V2=y
CONFIG_BATTERY_NOTIFIER=y
CONFIG_AFC_CHARGER_MODE=y
CONFIG_SAMSUNG_LPM_MODE=y
CONFIG_BATTERY_SWELLING=y
CONFIG_CHARGER_SM5705=y
CONFIG_FUELGAUGE_SM5705=y
# CONFIG_AFC_CURR_CONTROL_BY_TEMP=y
CONFIG_BATTERY_AGE_FORECAST=y
# CONFIG_UPDATE_BATTERY_DATA is not set
CONFIG_BATTERY_CISD=y

# NFC & eSE
CONFIG_NFC_PN547=y
CONFIG_SEC_NFC_LOGGER=y

# TDMB
CONFIG_TDMB=y
CONFIG_TDMB_VENDOR_FCI=y
CONFIG_TDMB_FC8080=y
CONFIG_TDMB_SPI=y
CONFIG_TDMB_QUALCOMM=y
CONFIG_TDMB_XTAL_FREQ=y

# Audio
CONFIG_SND_SOC_DBMDX=y
CONFIG_SND_SOC_DBMDX_SND_CAPTURE=y
CONFIG_SND_SOC_TFA9872=y

#Camera
CONFIG_LEDS_SM5705=y
CONFIG_LEDS_SEPARATE_PREFLASH=y
#CONFIG_SAMSUNG_OIS_RUMBA_S4=y
#CONFIG_SAMSUNG_OIS_RUMBA_S6=y
CONFIG_DISABLE_OIS_SDM710=y
CONFIG_SAMSUNG_FRONT_EEPROM=y
CONFIG_CAMERA_SYSFS_V2=y
#CONFIG_SAMSUNG_SECURE_CAMERA=y
CONFIG_SAMSUNG_MULTI_CAMERA=y
CONFIG_CAMERA_DYNAMIC_MIPI=y
CONFIG_CAMERA_FRS_DRAM_TEST=y
CONFIG_USE_CAMERA_HW_BIG_DATA=y
CONFIG_CAMERA_SSM_I2C_ENV=y
CONFIG_CAM_EEPROM_READ_RETRY=y

# Sensor
CONFIG_SENSORS=y
CONFIG_SENSORS_SSC=y
CONFIG_ADSP_FACTORY=y
CONFIG_LSM6DSM_FACTORY=y
CONFIG_AK09918_FACTORY=y
CONFIG_VCNL36863_FACTORY=y
CONFIG_SUPPORT_PROX_AUTO_CAL=y

# Grip Sensor
CONFIG_SENSORS_A96T3X6=y

# Finger print sensor
CONFIG_SENSORS_FINGERPRINT=y
CONFIG_SENSORS_ET5XX=y
CONFIG_SENSORS_FP_SPI_NUMBER=15
CONFIG_SENSORS_FP_SPI_GPIO_START=81
CONFIG_SENSORS_FP_SPI_GPIO_END=84

#Motor
CONFIG_LEDS_QPNP_HAPTICS=y
CONFIG_MSM_VIBRATOR=y

#MPTCP
CONFIG_MPTCP=y 
CONFIG_SAMSUNG_MPTCP=y 
CONFIG_TCP_CONG_LIA=y
CONFIG_TCP_CONG_OLIA=y
CONFIG_TCP_CONG_WVEGAS=y
CONFIG_MPTCP_FULLMESH=y
CONFIG_MPTCP_NDIFFPORTS=y
CONFIG_MPTCP_BINDER=y
CONFIG_MPTCP_ROUNDROBIN=y
```
